## buildroot-external-s5000c/packages/rj-utils/utils-frwk/Config.in
```kconfig
#2024-10-24 create by sjw

config BR2_PACKAGE_UTILS_FRWK
	bool "utils-frwk"
	default y
	help
		utils-frwk git.

config UTILS_FRWK_DEBUG_MODE
	bool "utils-frwk debug mode"
	depends on BR2_PACKAGE_UTILS_FRWK
	default y
	help
		utils-frwk use XXX_OVERRIDE_SRCDIR.

choice
    prompt "src debug type"
    default UTILS_FRWK_DEBUG_LOCAL_MODE
	depends on UTILS_FRWK_DEBUG_MODE

config UTILS_FRWK_DEBUG_LOCAL_MODE
    bool "local debug type"
    help
		Src use local debug type(copy to output build).

config UTILS_FRWK_DEBUG_OVERRIDE_MODE
    bool "override debug type"
    help
		Src use override debug type(src local build).
endchoice


config UTILS_FRWK_REPO_DIRECTORY_LOCATION
	string "repos of utils-frwk"
	default "http://192.168.210.6.8080/TQ_FRWK"
	depends on BR2_PACKAGE_UTILS_FRWK
	depends on !UTILS_FRWK_DEBUG_MODE
	help
		reps of utils-frwk.

config UTILS_FRWK_DEPENDENCIES_MODULES
	string "depended on"
	default "json-c utils_com utils-cstm utils-adpl-api utils-adpl"
	depends on BR2_PACKAGE_UTILS_FRWK
	help
		depended on

config CONFIG_MNG_CLI_CMDXML_DIR
	string "XML DIR"
	default "/etc/cli/cmdxml"
	depends on BR2_PACKAGE_UTILS_FRWK
	help
		dir of commands XML file

config CONFIG_CLI_DEP_MOM
	bool "will cli depend on MOM"
	default y
	depends on BR2_PACKAGE_UTILS_FRWK
	help
		you can't register cli client if doesn't have MOM

	
```

## buildroot-external-s5000c/packages/rj-utils/utils_com/Config.in
```kconfig
#2024-10-17 create by sjw

config BR2_PACKAGE_UTILS_COM
	bool "utils_com"
	default y
	select BR2_PACKAGE_NCURSES
	select BR2_PACKAGE_ZLIB
#	select BR2_PACKAGE_LUA
	help
		utils_com git.

config UTILS_COM_DEBUG_MODE
	bool "utils_com debug mode"
	default y
	depends on BR2_PACKAGE_UTILS_COM
	help
		utils_com use XXX_OVERRIDE_SRCDIR.

choice
    prompt "src debug type"
    default UTILS_COM_DEBUG_LOCAL_MODE
	depends on UTILS_COM_DEBUG_MODE

config UTILS_COM_DEBUG_LOCAL_MODE
    bool "local debug type"
    help
		Src use local debug type(copy to output build).

config UTILS_COM_DEBUG_OVERRIDE_MODE
    bool "override debug type"
    help
		Src use override debug type(src local build).
endchoice


config UTILS_COM_REPO_DIRECTORY_LOCATION
	string "repos of utils_com"
	default "http://192.168.210.6.8080/TQ_CSTM"
	depends on BR2_PACKAGE_UTILS_COM
	depends on !UTILS_COM_DEBUG_MODE
	help
		reps of utils_com.

config UTILS_COM_DEPENDENCIES_MODULES
	string "pkg depended on"
	default "ncurses zlib"
	depends on BR2_PACKAGE_UTILS_COM
	help
		depended on
```
