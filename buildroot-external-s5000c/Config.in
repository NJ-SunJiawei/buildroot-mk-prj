## buildroot-external-s5000c/Config.in
```kconfig
#2024-10-17 create by sjw

menu "rj packages"
	source "$BR2_EXTERNAL_RJ_PATH/packages/dpdk/Config.in"
	source "$BR2_EXTERNAL_RJ_PATH/packages/rj-utils/Config.in"
endmenu
```

## buildroot-external-s5000c/packages/dpdk/Config.in
```kconfig
#2024-10-17 create by sjw

config BR2_PACKAGE_DPDK
	bool "dpdk"
	depends on BR2_TOOLCHAIN_HAS_THREADS # DPDK requires thread support
	select BR2_PACKAGE_PYTHON3
	select BR2_PACKAGE_PYTHON_PYELFTOOLS # runtime
	select BR2_PACKAGE_NUMACTL
	help
		DPDK is a set of libraries and drivers for fast packet processing.
		http://www.dpdk.org/

config BR2_PACKAGE_DPDK_KERNEL_MODULES
	bool "Install kernel modules"
	default n
	depends on BR2_PACKAGE_DPDK
```

## buildroot-external-s5000c/packages/rj-gnb/Config.in
```kconfig
menu "rj-gnb packages"
	source "$BR2_EXTERNAL_RJ_PATH/packages/rj-gnb/cu/Config.in"
endmenu
```

## buildroot-external-s5000c/packages/rj-gnb/cu/Config.in
```kconfig
#2024-10-24 create by sjw

config BR2_PACKAGE_CU
	bool "CU"
	default y
	help
		CU git.

config CU_DEBUG_MODE
	bool "CU debug mode"
	depends on BR2_PACKAGE_CU
	default y
	help
		CU use XXX_OVERRIDE_SRCDIR.

choice
    prompt "src debug type"
    default CU_DEBUG_LOCAL_MODE
	depends on CU_DEBUG_MODE

config CU_DEBUG_LOCAL_MODE
    bool "local debug type"
    help
		Src use local debug type(copy to output build).

config CU_DEBUG_OVERRIDE_MODE
    bool "override debug type"
    help
		Src use override debug type(src local build).
endchoice


config CU_REPO_DIRECTORY_LOCATION
	string "repos of CU"
	default "http://192.168.210.6.8080/TQ_CU"
	depends on BR2_PACKAGE_CU
	depends on !CU_DEBUG_MODE
	help
		reps of CU.

config CU_DEPENDENCIES_MODULES
	string "depended on"
	default "utils_com utils-cstm utils-adpl-api utils-adpl utils-frwk om"
	depends on BR2_PACKAGE_CU
	help
		depended on
##################################
config CU_MAX_CELL_SUPPORT
	int "CU_MAX_CELL_SUPPORT"
	default 12
	depends on BR2_PACKAGE_CU

config CU_MAX_UE_SUPPORT
	int "CU_MAX_UE_SUPPORT"
	default 7200
	depends on BR2_PACKAGE_CU
```

## buildroot-external-s5000c/packages/rj-pi/Config.in
```kconfig
menu "rj-pi packages"
	source "$BR2_EXTERNAL_RJ_PATH/packages/rj-pi/om/Config.in"
	source "$BR2_EXTERNAL_RJ_PATH/packages/rj-pi/tm/Config.in"
	source "$BR2_EXTERNAL_RJ_PATH/packages/rj-pi/sec/Config.in"
	source "$BR2_EXTERNAL_RJ_PATH/packages/rj-pi/inet-utils/Config.in"
	source "$BR2_EXTERNAL_RJ_PATH/packages/rj-pi/dfx/Config.in"
	source "$BR2_EXTERNAL_RJ_PATH/packages/rj-pi/upgrade/Config.in"
	source "$BR2_EXTERNAL_RJ_PATH/packages/rj-pi/bsp/Config.in"
	source "$BR2_EXTERNAL_RJ_PATH/packages/rj-pi/dev/Config.in"
endmenu
```

## buildroot-external-s5000c/packages/rj-pi/bsp/Config.in
```kconfig
#2024-10-24 create by sjw

config BR2_PACKAGE_BSP
	bool "bsp"
	default y
	help
		bsp git.

config BSP_DEBUG_MODE
	bool "bsp debug mode"
	depends on BR2_PACKAGE_BSP
	default y
	help
		bsp use XXX_OVERRIDE_SRCDIR.

choice
    prompt "src debug type"
    default BSP_DEBUG_LOCAL_MODE
	depends on BSP_DEBUG_MODE

config BSP_DEBUG_LOCAL_MODE
    bool "local debug type"
    help
		Src use local debug type(copy to output build).

config BSP_DEBUG_OVERRIDE_MODE
    bool "override debug type"
    help
		Src use override debug type(src local build).
endchoice


config BSP_REPO_DIRECTORY_LOCATION
	string "repos of BSP"
	default "http://192.168.210.6.8080/TQ_PI"
	depends on BR2_PACKAGE_BSP
	depends on !BSP_DEBUG_MODE
	help
		reps of bsp.

config BSP_DEPENDENCIES_MODULES
	string "depended on"
	default ""
	depends on BR2_PACKAGE_BSP
	help
		depended on
#################################
config KCONFIG_dfd
	bool "dfd"
	default y
	help
		from the dfd homepage

config QATVER
	string "qat version"
	default "1.7-4.6.0"
	help
		qat version
```

## buildroot-external-s5000c/packages/rj-pi/dev/Config.in
```kconfig
#2024-10-24 create by sjw

config BR2_PACKAGE_DEV
	bool "dev"
	default y
	help
		dev git.

config DEV_DEBUG_MODE
	bool "dev debug mode"
	depends on BR2_PACKAGE_DEV
	default y
	help
		dev use XXX_OVERRIDE_SRCDIR.

choice
    prompt "src debug type"
    default DEV_DEBUG_LOCAL_MODE
	depends on DEV_DEBUG_MODE

config DEV_DEBUG_LOCAL_MODE
    bool "local debug type"
    help
		Src use local debug type(copy to output build).

config DEV_DEBUG_OVERRIDE_MODE
    bool "override debug type"
    help
		Src use override debug type(src local build).
endchoice


config DEV_REPO_DIRECTORY_LOCATION
	string "repos of DEV"
	default "http://192.168.210.6.8080/TQ_PI"
	depends on BR2_PACKAGE_DEV
	depends on !DEV_DEBUG_MODE
	help
		reps of dev.

config DEV_DEPENDENCIES_MODULES
	string "depended on"
	default "utils-frwk utils-adpl-api utils-cstm utils_com bsp"
	depends on BR2_PACKAGE_DEV
	help
		depended on
```

## buildroot-external-s5000c/packages/rj-pi/dfx/Config.in
```kconfig
#2024-10-24 create by sjw

config BR2_PACKAGE_DFX
	bool "dfx"
	default y
	help
		dfx git.

config DFX_DEBUG_MODE
	bool "dfx debug mode"
	depends on BR2_PACKAGE_DFX
	default y
	help
		dfx use XXX_OVERRIDE_SRCDIR.

choice
    prompt "src debug type"
    default DFX_DEBUG_LOCAL_MODE
	depends on DFX_DEBUG_MODE

config DFX_DEBUG_LOCAL_MODE
    bool "local debug type"
    help
		Src use local debug type(copy to output build).

config DFX_DEBUG_OVERRIDE_MODE
    bool "override debug type"
    help
		Src use override debug type(src local build).
endchoice


config DFX_REPO_DIRECTORY_LOCATION
	string "repos of dfx"
	default "http://192.168.210.6.8080/TQ_PI"
	depends on BR2_PACKAGE_DFX
	depends on !DFX_DEBUG_MODE
	help
		reps of dfx.

config DFX_DEPENDENCIES_MODULES
	string "depended on"
	default "utils-frwk"
	depends on BR2_PACKAGE_DFX
	help
		depended on
##################################
config CONFIG_DEV_SC_CFG_DIR
	string "selfcheck items configure dir"
	default "/etc/dev_sc/item"
	depends on BR2_PACKAGE_DFX
	help
		configure dir of selfcheck items
```

## buildroot-external-s5000c/packages/rj-pi/inet-utils/Config.in
```kconfig
#2024-10-24 create by sjw

config BR2_PACKAGE_INET_UTILS
	bool "inet-utils"
	default y
	select BR2_PACKAGE_LIBCAP
	help
		inet-utils git.

config INET_UTILS_DEBUG_MODE
	bool "inet-utils debug mode"
	depends on BR2_PACKAGE_INET_UTILS
	default y
	help
		inet-utils use XXX_OVERRIDE_SRCDIR.

choice
    prompt "src debug type"
    default INET_UTILS_DEBUG_LOCAL_MODE
	depends on INET_UTILS_DEBUG_MODE

config INET_UTILS_DEBUG_LOCAL_MODE
    bool "local debug type"
    help
		Src use local debug type(copy to output build).

config INET_UTILS_DEBUG_OVERRIDE_MODE
    bool "override debug type"
    help
		Src use override debug type(src local build).
endchoice


config INET_UTILS_REPO_DIRECTORY_LOCATION
	string "repos of inet-utils"
	default "http://192.168.210.6.8080/TQ_PI"
	depends on BR2_PACKAGE_INET_UTILS
	depends on !INET_UTILS_DEBUG_MODE
	help
		reps of inet-utils.

config INET_UTILS_DEPENDENCIES_MODULES
	string "depended on"
	default "utils-frwk libcap"
	depends on BR2_PACKAGE_INET_UTILS
	help
		depended on
```

## buildroot-external-s5000c/packages/rj-pi/om/Config.in
```kconfig
#2024-10-24 create by sjw

config BR2_PACKAGE_OM
	bool "om"
	default y
	help
		om git.

config OM_DEBUG_MODE
	bool "om debug mode"
	depends on BR2_PACKAGE_OM
	default y
	help
		om use XXX_OVERRIDE_SRCDIR.

choice
    prompt "src debug type"
    default OM_DEBUG_LOCAL_MODE
	depends on OM_DEBUG_MODE

config OM_DEBUG_LOCAL_MODE
    bool "local debug type"
    help
		Src use local debug type(copy to output build).

config OM_DEBUG_OVERRIDE_MODE
    bool "override debug type"
    help
		Src use override debug type(src local build).
endchoice


config OM_REPO_DIRECTORY_LOCATION
	string "repos of om"
	default "http://192.168.210.6.8080/TQ_PI"
	depends on BR2_PACKAGE_OM
	depends on !OM_DEBUG_MODE
	help
		reps of om.

config OM_DEPENDENCIES_MODULES
	string "depended on"
	default "utils_com utils-cstm utils-adpl-api utils-adpl utils-frwk"
	depends on BR2_PACKAGE_OM
	help
		depended on
##################################
config CONFIG_BS_LOGGING_BBU
	int "BBU"
	default 1
	depends on BR2_PACKAGE_OM

config CONFIG_NOT_BS_LOGGING_BBU
	int "not BBU bs_logging"
	default 0
	depends on BR2_PACKAGE_OM
```

## buildroot-external-s5000c/packages/rj-pi/sec/Config.in
```kconfig
#2024-10-24 create by sjw

config BR2_PACKAGE_SEC
	bool "sec"
	default y
	help
		sec git.

config SEC_DEBUG_MODE
	bool "sec debug mode"
	depends on BR2_PACKAGE_SEC
	default y
	help
		sec use XXX_OVERRIDE_SRCDIR.

choice
    prompt "src debug type"
    default SEC_DEBUG_LOCAL_MODE
	depends on SEC_DEBUG_MODE

config SEC_DEBUG_LOCAL_MODE
    bool "local debug type"
    help
		Src use local debug type(copy to output build).

config SEC_DEBUG_OVERRIDE_MODE
    bool "override debug type"
    help
		Src use override debug type(src local build).
endchoice


config SEC_REPO_DIRECTORY_LOCATION
	string "repos of sec"
	default "http://192.168.210.6.8080/TQ_PI"
	depends on BR2_PACKAGE_SEC
	depends on !SEC_DEBUG_MODE
	help
		reps of sec.

config SEC_DEPENDENCIES_MODULES
	string "depended on"
	default "utils-frwk"
	depends on BR2_PACKAGE_SEC
	help
		depended on
```

## buildroot-external-s5000c/packages/rj-pi/tm/Config.in
```kconfig
#2024-10-24 create by sjw

config BR2_PACKAGE_TM
	bool "tm"
	default y
	help
		tm git.

config TM_DEBUG_MODE
	bool "tm debug mode"
	depends on BR2_PACKAGE_TM
	default y
	help
		tm use XXX_OVERRIDE_SRCDIR.

choice
    prompt "src debug type"
    default TM_DEBUG_LOCAL_MODE
	depends on TM_DEBUG_MODE

config TM_DEBUG_LOCAL_MODE
    bool "local debug type"
    help
		Src use local debug type(copy to output build).

config TM_DEBUG_OVERRIDE_MODE
    bool "override debug type"
    help
		Src use override debug type(src local build).
endchoice


config TM_REPO_DIRECTORY_LOCATION
	string "repos of tm"
	default "http://192.168.210.6.8080/TQ_PI"
	depends on BR2_PACKAGE_TM
	depends on !TM_DEBUG_MODE
	help
		reps of tm.

config TM_DEPENDENCIES_MODULES
	string "depended on"
	default "utils-frwk"
	depends on BR2_PACKAGE_TM
	help
		depended on
```

## buildroot-external-s5000c/packages/rj-pi/upgrade/Config.in
```kconfig
#2024-10-24 create by sjw

config BR2_PACKAGE_UPGRADE
	bool "upgrade"
	default y
	help
		upgrade git.

config UPGRADE_DEBUG_MODE
	bool "upgrade debug mode"
	depends on BR2_PACKAGE_UPGRADE
	default y
	help
		upgrade use XXX_OVERRIDE_SRCDIR.

choice
    prompt "src debug type"
    default UPGRADE_DEBUG_LOCAL_MODE
	depends on UPGRADE_DEBUG_MODE

config UPGRADE_DEBUG_LOCAL_MODE
    bool "local debug type"
    help
		Src use local debug type(copy to output build).

config UPGRADE_DEBUG_OVERRIDE_MODE
    bool "override debug type"
    help
		Src use override debug type(src local build).
endchoice


config UPGRADE_REPO_DIRECTORY_LOCATION
	string "repos of UPGRADE"
	default "http://192.168.210.6.8080/TQ_PI"
	depends on BR2_PACKAGE_UPGRADE
	depends on !UPGRADE_DEBUG_MODE
	help
		reps of upgrade.

config UPGRADE_DEPENDENCIES_MODULES
	string "depended on"
	default "utils-frwk"
	depends on BR2_PACKAGE_UPGRADE
	help
		depended on
```

## buildroot-external-s5000c/packages/rj-utils/Config.in
```kconfig
menu "rj-utils packages"
	source "$BR2_EXTERNAL_RJ_PATH/packages/rj-utils/utils_com/Config.in"
#	source "$BR2_EXTERNAL_RJ_PATH/packages/rj-utils/utils-adpl/Config.in"
#	source "$BR2_EXTERNAL_RJ_PATH/packages/rj-utils/utils-adpl-api/Config.in"
#	source "$BR2_EXTERNAL_RJ_PATH/packages/rj-utils/utils-cstm/Config.in"
#	source "$BR2_EXTERNAL_RJ_PATH/packages/rj-utils/utils-frwk/Config.in"
endmenu
```

## buildroot-external-s5000c/packages/rj-utils/utils-adpl-api/Config.in
```kconfig
#2024-10-24 create by sjw

config BR2_PACKAGE_UTILS_ADPL_API
	bool "utils-adpl-api"
	default y
	select BR2_PACKAGE_LIBXML2
	help
		utils-adpl-api git.

config UTILS_ADPL_API_DEBUG_MODE
	bool "utils-adpl-api debug mode"
	depends on BR2_PACKAGE_UTILS_ADPL_API
	default y
	help
		utils-adpl-api use XXX_OVERRIDE_SRCDIR.

choice
    prompt "src debug type"
    default UTILS_ADPL_API_DEBUG_LOCAL_MODE
	depends on UTILS_ADPL_API_DEBUG_MODE

config UTILS_ADPL_API_DEBUG_LOCAL_MODE
    bool "local debug type"
    help
		Src use local debug type(copy to output build).

config UTILS_ADPL_API_DEBUG_OVERRIDE_MODE
    bool "override debug type"
    help
		Src use override debug type(src local build).
endchoice


config UTILS_ADPL_API_REPO_DIRECTORY_LOCATION
	string "repos of utils-adpl-api"
	default "http://192.168.210.6.8080/TQ_ADPL"
	depends on BR2_PACKAGE_UTILS_ADPL_API
	depends on !UTILS_ADPL_API_DEBUG_MODE
	help
		reps of utils-adpl-api.

config UTILS_ADPL_API_DEPENDENCIES_MODULES
	string "depended on"
	default "libxml2 utils_com utils-cstm"
	depends on BR2_PACKAGE_UTILS_ADPL_API
	help
		depended on
```

## buildroot-external-s5000c/packages/rj-utils/utils-adpl/Config.in
```kconfig
#2024-10-24 create by sjw

config BR2_PACKAGE_UTILS_ADPL
	bool "utils-adpl"
	default y
	help
		utils-adpl git.

config UTILS_ADPL_DEBUG_MODE
	bool "utils-adpl debug mode"
	depends on BR2_PACKAGE_UTILS_ADPL
	default y
	help
		utils-adpl use XXX_OVERRIDE_SRCDIR.

choice
    prompt "src debug type"
    default UTILS_ADPL_DEBUG_LOCAL_MODE
	depends on UTILS_ADPL_DEBUG_MODE

config UTILS_ADPL_DEBUG_LOCAL_MODE
    bool "local debug type"
    help
		Src use local debug type(copy to output build).

config UTILS_ADPL_DEBUG_OVERRIDE_MODE
    bool "override debug type"
    help
		Src use override debug type(src local build).
endchoice


config UTILS_ADPL_REPO_DIRECTORY_LOCATION
	string "repos of utils-adpl"
	default "http://192.168.210.6.8080/TQ_ADPL"
	depends on BR2_PACKAGE_UTILS_ADPL
	depends on !UTILS_ADPL_DEBUG_MODE
	help
		reps of utils-adpl.

config UTILS_ADPL_DEPENDENCIES_MODULES
	string "depended on"
	default "utils_com utils-cstm utils-adpl-api"
	depends on BR2_PACKAGE_UTILS_ADPL
	help
		depended on
```

## buildroot-external-s5000c/packages/rj-utils/utils-cstm/Config.in
```kconfig
#2024-10-24 create by sjw

config BR2_PACKAGE_UTILS_CSTM
	bool "utils-cstm"
	default y
	#select BR2_PACKAGE_DPDK
	help
		utils-cstm git.

config UTILS_CSTM_DEBUG_MODE
	bool "utils-cstm debug mode"
	depends on BR2_PACKAGE_UTILS_CSTM
	default y
	help
		utils-cstm use XXX_OVERRIDE_SRCDIR.

choice
    prompt "src debug type"
    default UTILS_CSTM_DEBUG_LOCAL_MODE
	depends on UTILS_CSTM_DEBUG_MODE

config UTILS_CSTM_DEBUG_LOCAL_MODE
    bool "local debug type"
    help
		Src use local debug type(copy to output build).

config UTILS_CSTM_DEBUG_OVERRIDE_MODE
    bool "override debug type"
    help
		Src use override debug type(src local build).
endchoice


config UTILS_CSTM_REPO_DIRECTORY_LOCATION
	string "repos of utils-cstm"
	default "http://192.168.210.6.8080/TQ_CSTM"
	depends on BR2_PACKAGE_UTILS_CSTM
	depends on !UTILS_CSTM_DEBUG_MODE
	help
		reps of utils-cstm.

config UTILS_CSTM_DEPENDENCIES_MODULES
	string "depended on"
	default "linux utils_com" #dpdk 
	depends on BR2_PACKAGE_UTILS_CSTM
	help
		depended on

config CONFIG_RG_MOM_SYSTEMD
	bool "5g mom systemd sh"
	default n
	depends on BR2_PACKAGE_UTILS_CSTM
	help
		5g-mom-systemd-sh

config RG_MOM_CLIENT_STATIC_BUFFER
	bool "5g rg-mom static buffer"
	default n
	depends on BR2_PACKAGE_UTILS_CSTM
	help
		5g rg-mom-static-buffer

########################################
config BR2_PACKAGE_DPDK_ARCH_CONFIG
	string "dpdk config"
	default "i686-native-linux-gcc" if BR2_x86_i686
	default "x86_64-native-linux-gcc" if BR2_x86_64
	default "arm64-armv8a-linux-gcc" if BR2_aarch64 || BR2_aarch64_be
	depends on BR2_PACKAGE_UTILS_CSTM

config DPDK_VER
	string "dpdk version"
	default "19.11.5"
	depends on BR2_PACKAGE_UTILS_CSTM
	help
		DPDK version
	
config MESON_BUILD
	bool "meson build or not"
	default n
	depends on BR2_PACKAGE_UTILS_CSTM
	help
		MESON build

config DPDK_CROSS_FILE
	string "DPDK cross file"
	default ""
	depends on BR2_PACKAGE_UTILS_CSTM
	help
		DPDK cross file
```
